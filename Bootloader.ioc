# file: Bootloader.ioc
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IWDG.Prescaler=IWDG_PRESCALER_256
Mcu.Family=STM32F4
Mcu.Name=STM32F407Z(E-G)Tx
Mcu.Package=LQFP144
NVIC.PriorityGroup=NVIC_PRIORITYGROUP_4
PA13.Mode=Serial_Wire
PA13.Signal=SYS_JTMS-SWDIO
PA14.Mode=Serial_Wire
PA14.Signal=SYS_JTCK-SWCLK
PH0-OSC_IN.Mode=HSE-External-Oscillator
PH0-OSC_IN.Signal=RCC_OSC_IN
PH1-OSC_OUT.Mode=HSE-External-Oscillator
PH1-OSC_OUT.Signal=RCC_OSC_OUT
ProjectManager.HeapSize=0x200
ProjectManager.StackSize=0x400
ProjectManager.TargetToolchain=Makefile
RCC.48MHZClocksFreq_Value=84000000
RCC.AHBFreq_Value=168000000
RCC.APB1CLKDivider=RCC_HCLK_DIV4
RCC.APB1Freq_Value=42000000
RCC.APB1TimFreq_Value=84000000
RCC.APB2CLKDivider=RCC_HCLK_DIV2
RCC.APB2Freq_Value=84000000
RCC.APB2TimFreq_Value=168000000
RCC.CortexFreq_Value=168000000
RCC.HCLKFreq_Value=168000000
RCC.HSE_VALUE=8000000
RCC.HSI_VALUE=16000000
RCC.LSE_VALUE=32768
RCC.PLLM=4
RCC.PLLN=168
RCC.PLLSourceVirtual=RCC_PLLSOURCE_HSE
RCC.SYSCLKFreq_VALUE=168000000
RCC.SYSCLKSource=RCC_SYSCLKSOURCE_PLLCLK
RCC.VCOOutputFreq_Value=336000000
VP_CRC_VS_CRC.Mode=CRC_Activate
VP_IWDG_VS_IWDG.Mode=IWDG_Activate
VP_RTC_VS_RTC_Activate.Mode=RTC_Enabled
board=custom

// file: Core/Src/main.c
/* USER CODE BEGIN Header */
/**
 ******************************************************************************
 * @file           : main.c
 * @brief          : Main program body
 ******************************************************************************
 * @attention
 *
 * Copyright (c) 2026 STMicroelectronics.
 * All rights reserved.
 *
 * This software is licensed under terms that can be found in the LICENSE file
 * in the root directory of this software component.
 * If no LICENSE file comes with this software, it is provided AS-IS.
 *
 ******************************************************************************
 */
/* USER CODE END Header */
#include "main.h"
#include "crc.h"
#include "iwdg.h"
#include "rtc.h"
#include "gpio.h"

/* USER CODE BEGIN Includes */
#include "jump2app.h"
#include "config_info.h"
#include <stdbool.h>
/* USER CODE END Includes */

void SystemClock_Config(void);

int main(void)
{

    /* MCU Configuration--------------------------------------------------------*/

    /* Reset of all peripherals, Initializes the Flash interface and the Systick. */
    HAL_Init();

    /* Configure the system clock */
    SystemClock_Config();

    /* Initialize all configured peripherals */
    MX_GPIO_Init();
    MX_CRC_Init();
    MX_IWDG_Init();
    MX_RTC_Init();
    /* USER CODE BEGIN 2 */

    uint32_t jump_target = ADDR_RECOVERY_APP; // 默认Recovery

    // 判断是否增加崩溃计数
    if (__HAL_RCC_GET_FLAG(RCC_FLAG_IWDGRST)) {
        uint32_t crash_cnt = HAL_RTCEx_BKUPRead(&hrtc, RTC_BKP_DR1) + 1;
        HAL_RTCEx_BKUPWrite(&hrtc, RTC_BKP_DR1, crash_cnt);
        __HAL_RCC_CLEAR_RESET_FLAGS();
    }

    // 读取崩溃计数和强制升级标志
    uint32_t force_flag   = HAL_RTCEx_BKUPRead(&hrtc, RTC_BKP_DR0);
    uint32_t crash_count  = HAL_RTCEx_BKUPRead(&hrtc, RTC_BKP_DR1);
    SysInfo_t *pConfig    = (SysInfo_t *)ADDR_CONFIG_SECTOR;
    SysInfo_t config_info = {0};

    if (force_flag == FLAG_FORCE_UPGRADE) { // 条件A: 强制升级标志
        HAL_RTCEx_BKUPWrite(&hrtc, RTC_BKP_DR0, 0);
        jump_target = ADDR_RECOVERY_APP;

        memcpy(&config_info, pConfig, sizeof(config_info));
        config_info.update_sta = failed;
        Edit_Config_Info(&config_info);

    } else if (crash_count > MAX_CRASH_COUNT) { // 条件B: 崩溃过频
        HAL_RTCEx_BKUPWrite(&hrtc, RTC_BKP_DR1, 0);
        jump_target = ADDR_RECOVERY_APP;

        memcpy(&config_info, pConfig, sizeof(config_info));
        config_info.update_sta = failed;
        Edit_Config_Info(&config_info);

    } else if (Is_Config_Empty(pConfig)) { // 条件C: 出厂烧录状态
        Init_Config_Info(&config_info);

        if (Is_App_Exist(ADDR_MAIN_APP))
            jump_target = ADDR_MAIN_APP; // 首次运行
        else
            jump_target = ADDR_RECOVERY_APP; // 无Main

    } else { // 条件D: 校验Config和Main App的CRC
        // 首先校验Config Info自身的CRC32
        uint32_t calc_cfg_crc = HAL_CRC_Calculate(&hcrc, (uint32_t *)pConfig, (sizeof(SysInfo_t) - sizeof(pConfig->config_crc)) / 4);

        if ((pConfig->magic == CONFIG_MAGIC) && (calc_cfg_crc == pConfig->config_crc)) {
            do {
                // 先判断升级状态机，状态机有误则直接进recovery
                if (pConfig->update_sta != updated) { // 升级未完成，需要进recovery处理
                    jump_target = ADDR_RECOVERY_APP;
                    break; // 通过break while实现提前跳出
                }
// #define DEBUG_MODE
#ifdef DEBUG_MODE
                if (Is_App_Exist(ADDR_MAIN_APP)) {
                    jump_target = ADDR_MAIN_APP; // debug模式下只需要校验是否有栈指针
#else
                // 校验Main App实体
                uint32_t app_word_len = (pConfig->app_info.size + 3) / 4;
                uint32_t calc_app_crc = HAL_CRC_Calculate(&hcrc, (uint32_t *)ADDR_MAIN_APP, app_word_len);
                if (calc_app_crc == pConfig->app_info.crc32 && Is_App_Exist(ADDR_MAIN_APP)) {
                    jump_target = ADDR_MAIN_APP; // 非debug模式下需要同时校验app实体和栈指针
#endif

                } else { // App损坏
                    jump_target = ADDR_RECOVERY_APP;

                    SysInfo_t config_info = {0};
                    memcpy(&config_info, pConfig, sizeof(config_info));
                    config_info.update_sta = failed;
                    Edit_Config_Info(&config_info);
                }
            } while (false);
        } else if (pConfig->magic == CONFIG_MAGIC) {
            // magic 匹配但 config_crc 校验失败：Sector1 擦写中途掉电的半写态
            // （magic 已写、config_crc 未写完/损坏）。走条件 C 重建出厂记录自愈：
            // EraseConfigInfo + Init_Config_Info 写出厂记录（update_sta=updated、
            // app_info.size=0、crc32=0xFFFFFFFF），随后按条件 C 现有逻辑跳转——
            // 主固件存在 → 跳 0x08040000。重建后的出厂记录经条件 D 校验时
            // 0 长度 CRC 恒匹配，仍能正确跳主固件，勿改该哨兵值语义。
            // 注意区分：config_crc 错 → 重建；config_crc 对但 app CRC 不匹配
            // （App 损坏）→ 仍跳 Recovery 由升级流程修复，勿改。
            Init_Config_Info(&config_info);

            if (Is_App_Exist(ADDR_MAIN_APP))
                jump_target = ADDR_MAIN_APP; // 首次运行
            else
                jump_target = ADDR_RECOVERY_APP; // 无Main
        }
    }

    // 跳转前的清理工作
    HAL_IWDG_Refresh(&hiwdg);

    HAL_RCC_DeInit();
    HAL_DeInit();
    SysTick->CTRL = 0;
    SysTick->LOAD = 0;
    SysTick->VAL  = 0;

    // 确认跳转地址存在栈指针
    if (Is_App_Exist(jump_target)) {
        __disable_irq();
        execute_jump(jump_target);
    }

    /* USER CODE END 2 */

    /* Infinite loop */
    /* USER CODE BEGIN WHILE */
    for (;;) { // 如果跳转失败则死循环触发看门狗
        /* USER CODE END WHILE */

    }
}

void SystemClock_Config(void)
{
    RCC_OscInitTypeDef RCC_OscInitStruct = {0};
    RCC_ClkInitTypeDef RCC_ClkInitStruct = {0};

    /** Configure the main internal regulator output voltage
     */
    __HAL_RCC_PWR_CLK_ENABLE();
    __HAL_PWR_VOLTAGESCALING_CONFIG(PWR_REGULATOR_VOLTAGE_SCALE1);

    /** Initializes the RCC Oscillators according to the specified parameters
     * in the RCC_OscInitTypeDef structure.
     */
    RCC_OscInitStruct.OscillatorType = RCC_OSCILLATORTYPE_LSI | RCC_OSCILLATORTYPE_HSE;
    RCC_OscInitStruct.HSEState       = RCC_HSE_ON;
    RCC_OscInitStruct.LSIState       = RCC_LSI_ON;
    RCC_OscInitStruct.PLL.PLLState   = RCC_PLL_ON;
    RCC_OscInitStruct.PLL.PLLSource  = RCC_PLLSOURCE_HSE;
    RCC_OscInitStruct.PLL.PLLM       = 4;
    RCC_OscInitStruct.PLL.PLLN       = 168;
    RCC_OscInitStruct.PLL.PLLP       = RCC_PLLP_DIV2;
    RCC_OscInitStruct.PLL.PLLQ       = 4;
    if (HAL_RCC_OscConfig(&RCC_OscInitStruct) != HAL_OK) {
        Error_Handler();
    }

    /** Initializes the CPU, AHB and APB buses clocks
     */
    RCC_ClkInitStruct.ClockType      = RCC_CLOCKTYPE_HCLK | RCC_CLOCKTYPE_SYSCLK | RCC_CLOCKTYPE_PCLK1 | RCC_CLOCKTYPE_PCLK2;
    RCC_ClkInitStruct.SYSCLKSource   = RCC_SYSCLKSOURCE_PLLCLK;
    RCC_ClkInitStruct.AHBCLKDivider  = RCC_SYSCLK_DIV1;
    RCC_ClkInitStruct.APB1CLKDivider = RCC_HCLK_DIV4;
    RCC_ClkInitStruct.APB2CLKDivider = RCC_HCLK_DIV2;

    if (HAL_RCC_ClockConfig(&RCC_ClkInitStruct, FLASH_LATENCY_5) != HAL_OK) {
        Error_Handler();
    }
}

void Error_Handler(void)
{
    /* USER CODE BEGIN Error_Handler_Debug */
    /* User can add his own implementation to report the HAL error return state */
    __disable_irq();
    for (;;);
    /* USER CODE END Error_Handler_Debug */
}
